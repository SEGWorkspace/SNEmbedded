AUTOSAR XML (schema 00049)
package /Signals
  i signal CoolantTemperature: length=8, system-signal=CoolantTemp
  i signal VehicleSpeed: length=16, system-signal=VehicleSpeed
  i signal GearPosition: length=4, system-signal=GearPosition
package /Pdus
  pdu EngineData_Pdu: length=8, transmission-mode-true-timing=cyclic-timing=time-period=0.02
    signal EngineSpeed: start 8, 16 bit, big-endian, init-value=800
