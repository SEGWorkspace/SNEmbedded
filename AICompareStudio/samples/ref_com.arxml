AUTOSAR XML (schema 4-2-2)
package /Signals
  i signal CoolantTemp: length=8, system-signal=CoolantTemp
  i signal VehicleSpeed: length=12, system-signal=VehicleSpeed
package /Pdus
  pdu EngineData_Pdu: length=8, transmission-mode-true-timing=cyclic-timing=time-period=0.01
    signal EngineSpeed: start 0, 16 bit, little-endian, init-value=0
